## boards/rapidsilicon/virgo_proto/virgo_proto_defconfig
```kconfig
CONFIG_XIP=y
CONFIG_CONSOLE=y
CONFIG_UART_CONSOLE=y

# Serial driver options
CONFIG_SERIAL=y

# GPIO driver options
CONFIG_GPIO=n

# Syscon driver options
CONFIG_SYSCON=n

# hwinfo driver options
CONFIG_HWINFO=n
CONFIG_HWINFO_ANDES=n

# FPU (single precision) options
#CONFIG_FPU=y
#CONFIG_FPU_SHARING=y
#CONFIG_FLOAT_HARD=y
#CONFIG_SINGLE_PRECISION_FPU=y

# FPU (double precision) options
#CONFIG_FPU=y
#CONFIG_FPU_SHARING=y
#CONFIG_FLOAT_HARD=y
#CONFIG_DOUBLE_PRECISION_FPU=y

# HW DSP options
#CONFIG_SOC_ANDES_V5_HWDSP=y

# EXEC.IT options
# CONFIG_SOC_ANDES_V5_EXECIT=y

# Sys Clock HW Cycles for Virgo Proto used by mtimer
CONFIG_SYS_CLOCK_HW_CYCLES_PER_SEC=13333333

# Enabling the SPI Peripheral
CONFIG_SPI=n
CONFIG_SPI_NOR=n

# Enabling the Crypto Peripheral
CONFIG_CRYPTO=n
CONFIG_PUFCC_SECURITY=n
CONFIG_CRYPTO_PUF_SECURITY=n
CONFIG_CRYPTO_PUF_SECURITY_OTP=n

# Enabling the DMA Peripheral
CONFIG_DMA=n
CONFIG_DMA_ANDES_ATCDMAC100=n

# Enabling the SPI and Flash Peripheral
CONFIG_FLASH=n
CONFIG_SPI_NOR_SFDP_DEVICETREE=n
CONFIG_SPI_ANDES_ATCSPI200=n
CONFIG_ANDES_SPI_DMA_MODE=n

# Enabling the Counter Peripheral
CONFIG_COUNTER=n
CONFIG_COUNTER_ANDES_ATCPIT100=n

# Enabling the Sensor Peripheral
CONFIG_SENSOR=n
CONFIG_DTI_PVT=n

# Enable Rapid Silicon Specific IPs
CONFIG_RAPIDSI_OFE=y

# Enable Rapid Silicon Pin Controller
CONFIG_PINCTRL=y
CONFIG_PINCTRL_RAPIDSI=y

# Enable FPGA Bitstream loading functionality
CONFIG_FPGA=n
CONFIG_RS_FPGA=n
CONFIG_RS_FPGA_FCB=n
CONFIG_RS_FPGA_ICB=n
CONFIG_RS_FPGA_PCB=n

CONFIG_RISCV_VECTORED_MODE=n
CONFIG_RISCV_TRAP_HANDLER_ALIGNMENT=64

CONFIG_TRACING=y
CONFIG_PERCEPIO_TRACERECORDER=y
CONFIG_PERCEPIO_TRC_START_MODE_START=y
CONFIG_PERCEPIO_TRC_CFG_STREAM_PORT_RINGBUFFER=y
CONFIG_PERCEPIO_TRC_CFG_STREAM_PORT_RINGBUFFER_SIZE=8092
```

## boards/rapidsilicon/virgo_tc_eval_soc_proto/Kconfig.board
```kconfig
# Copyright (c) 2024 Rapid Silicon
# SPDX-License-Identifier: Apache-2.0

config BOARD_VIRGO_TC_EVAL_SOC_PROTO
	bool "virgo_tc_eval_soc_proto"
	depends on SOC_VIRGO
```

## boards/rapidsilicon/virgo_tc_eval_soc_proto/Kconfig.defconfig
```kconfig
# Copyright (c) 2024 Rapid Silicon
# SPDX-License-Identifier: Apache-2.0

config BOARD
	default "virgo_tc_eval" if BOARD_VIRGO_TC_EVAL_SOC_PROTO
```

## boards/rapidsilicon/virgo_tc_eval_soc_proto/Kconfig.virgo_tc_eval_soc_proto
```kconfig
# Copyright (c) 2021 Andes Technology Corporation
# SPDX-License-Identifier: Apache-2.0

config BOARD_VIRGO_TC_EVAL_SOC_PROTO
	select SOC_VIRGO if BOARD_VIRGO_TC_EVAL_SOC_PROTO
```

## boards/rapidsilicon/virgo_tc_eval_soc_proto/board.yml
```yaml
board:
  name: virgo_tc_eval_soc_proto
  vendor: rapidsi
  socs:
  - name: virgo
```

## drivers/sensor/dti/Kconfig
```kconfig
# Copyright (c) 2024 Rapid Silicon.
# SPDX-License-Identifier: Apache-2.0

menuconfig DTI_PVT
    bool "DTI Process, Voltage and Thermal Sensor Configuration"
    default n
    depends on SENSOR
    depends on DT_HAS_DTI_PVT_ENABLED

    menu "PVT Timing Configuration Register Values"
        depends on DTI_PVT

        config DTI_PVT_RST_TREG_TIMEOUT
            hex "Enter Timeout Value"
            default 0x80
                help
                    This is the timeout value for process monitor

        config DTI_PVT_RST_TREG_EN
            hex "Enter the Enable Time value"
            default 0x14
                help
                    Enable time before starting the monitor/sensor, RoundUp(100ns * CLK)

        config DTI_PVT_RST_TREG_MSTEP
            hex "Enter the measurement time value"
            default 0x6
                help
                    Measuring time, RoundUp(30ns * CLK)
              
    endmenu

    menu "PVT config register"        
        depends on DTI_PVT

        config DTI_PVT_RST_CONF_TRIM
            hex "Enter the resistor adjustment value"
            default 0x6
                help
                    Resistor value adjustment for post silicon to calibrate to simualtion results

        config DTI_PVT_RST_CONF_FREQRANGE
            int "Enter to Select Frequency Range"
            range 0 1
            default 0
                help
                    Clock Frquency range. Enter 1 for frequence range below 75MHz or
                    Enter 0 for the frequence range between 75MHz and 200MHz.

        config DTI_PVT_RST_CONF_DIV
            int "Enter the Frequency Division Factor"
            default 5
                help
                    Division factor 
                        If freqrange = 0: 
                            DIV = 1200/Freq_Mhz - 1
                            DIV = 5 for 200 Mhz
                            DIV = 7 for 150 Mhz
                            DIV = 8 for 133 Mhz
                            DIV = 11 for 100 Mhz
                            DIV = 15 for 75 Mhz
                        If freqrange = 1: 
                            DIV = 600/Freq_Mhz – 1
                            DIV = 11 for 50Mhz"

        config DTI_PVT_RST_CONF_VMRANGE
            int "Enter to select VM Range"
            range 0 1
            default 0
                help
                    Voltage Monitor Range. Enter 1 for VM range to monitor
                    the voltage between 0 - 2 volts. And Enter 0 for VM range
                    of 0 - 1 volts.

        config DTI_PVT_RST_CONF_VMCAL_OFFSET
            hex "Enter the Voltage calibration offset in signed two's complement"
            default 0x0
                help
                    Voltage Calibration Offset (in signed two's complement format). Used to 
                    adjust VM Code depended on Silicon corner.

        config DTI_PVT_RST_CONF_TSCAL_OFFSET
            hex "Enter the Thermal calibration offset in signed two's complement"
            default 0x0
                help
                    Thermal Calibration Offset (in signed two's complement format). Used to 
                    adjust TS Code depended on Silicon corner.

    endmenu

module = DTI_PVT
module-str = dti_pvt
source "subsys/logging/Kconfig.template.log_config"
```

## dts/bindings/crypto/pufcc.yaml
```yaml
# Copyright (c) 2024, Rapid Silicon
# SPDX-License-Identifier: Apache-2.0

include: base.yaml

properties:
  reg:
    required: true

  interrupts:
    required: true
```

## dts/bindings/sram/rapidsi,mem.yaml
```yaml
# Copyright (c) 2024, Rapid Silicon
# SPDX-License-Identifier: Apache-2.0

description: Generic on-chip Memory description

compatible: "rapidsi,ocm"

include: base.yaml

properties:
  reg:
    required: true
```

## soc/rapidsilicon/virgo/Kconfig
```kconfig
# Copyright (c) 2021 Andes Technology Corporation
# SPDX-License-Identifier: Apache-2.0

config SOC_SERIES_VIRGO
	select RISCV
	select RISCV_PRIVILEGED
	select RISCV_HAS_CLIC

config SOC_VIRGO
	select ATOMIC_OPERATIONS_BUILTIN
	select INCLUDE_RESET_VECTOR
	select RISCV_ISA_RV32I
	select RISCV_ISA_EXT_M
	select RISCV_ISA_EXT_A
	# select RISCV_ISA_EXT_C
	select RISCV_ISA_EXT_ZICSR

if SOC_SERIES_VIRGO

config SOC_ANDES_V5_EXECIT
	bool "Andes V5 EXEC.IT extension"
	depends on RISCV_ISA_EXT_C
	depends on !RISCV_GENERIC_TOOLCHAIN
	depends on !LINKER_USE_NO_RELAX
	help
		The EXEC.IT extension (Execution on Instruction Table) generate
		a look-up table and replaces suitable 32-bit instructions with
		the 16-bit "exec.it <INDEX>".

endif # SOC_SERIES_VIRGO
```
